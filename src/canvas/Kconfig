## src/moonwater/Kconfig
```kconfig
menu "Moonwater"
    config MOONWATER_CORE
        tristate "Moonwater core"
        default y
        help
          Enable the Moonwater core: the spark binary format and /dev/spark

    config MOONWATER_FLOODLIGHT
        bool "Floodlight: the runtime allowance register"
        default y
        help
          Build /dev/floodlight: every runtime allowance on this machine in one
          array, readable with cat and changed one line at a time until sealed.

          Deliberately depends on nothing. Floodlight is its own trusted base --
          one file of ordinary kernel C that includes only <linux/...>, names
          nothing Moonwater defines, exports no symbols and is linked by nothing.
          Making it depend on MOONWATER_CORE would put the compositor and the
          terminal emulator inside the trusted base of a policy decision, which
          is the whole thing it is built to avoid. The floodlight harness in
          test/differential.py fails the build if that separation ever slips.

          Out of the box it refuses nothing: every tool behaves as its bash,
          dash or GNU counterpart does. The options below are where a machine
          says otherwise, and what they refuse stays refused -- a script that
          breaks under them is the policy doing what it was asked to.

    config MOONWATER_FLOODLIGHT_POLICY
        string "Floodlight: built-in policy rows"
        depends on MOONWATER_FLOODLIGHT
        default ""
        help
          Rows compiled into the register as built-in answers, in the words a
          line written to /dev/floodlight takes, separated by semicolons:

            awk spawn deny; tar flag --to-command deny; /usr/bin/curl network deny

          A row is SUBJECT SETTING STATE, or SUBJECT flag FLAG STATE. SUBJECT
          is an applet name or an absolute path; SETTING is run (may it start
          at all), flag (may it be given this argument), spawn (may it start
          other programs) or network (may it open sockets); STATE is allow or
          deny. The shell carries the same rows for when the register cannot
          be read. Rows here win over the dangerous-flag switches below, and
          a row named twice is taken the first time; at most 64 rows in all.

          A row that does not read is not skipped, because skipping a refusal
          is an allowance nobody wrote: the register then refuses to answer
          and every launch is refused until this is fixed.

    config MOONWATER_FLOODLIGHT_SEAL
        bool "Floodlight: seal the policy at boot"
        depends on MOONWATER_FLOODLIGHT
        default n
        help
          Seal the register before it is registered, as `echo seal >
          /dev/floodlight` would once the machine is up. The configured rows
          are then the whole policy until reboot: root can read the register
          and cannot loosen it. Leave this off to keep runtime changes.

    menu "Floodlight: dangerous flags"
        depends on MOONWATER_FLOODLIGHT

    comment "Each switch, turned off, adds the deny rows that close one exploit class"

    config MOONWATER_FLOODLIGHT_AWK_SPAWN
        bool "awk may start programs: system(), print | cmd, cmd | getline"
        default y
        help
          Off adds `awk spawn deny`. Closes data-driven command execution:
          awk is the one common tool where the name of the program to run is
          built out of its input, because awk program text arrives in files
          and variables. With it off, awk still runs; its system() and pipes
          fail under a seccomp filter installed before awk reads a byte.

          Confinement needs the launching shell to prove things through /proc
          (no inherited filter, a protected parent, a script it can freeze),
          so awk refuses to start where it cannot: from a foreign shell, with
          /proc masked, or while the shell reads its script from a pipe.

    config MOONWATER_FLOODLIGHT_SHELL_ESCAPES
        bool "script, setarch and split --filter may start a shell"
        default y
        help
          Off adds `script spawn deny`, `setarch spawn deny` and `split flag
          --filter deny`. Closes the shell escape: script's session and
          setarch with no command are each a shell, and split --filter hands
          its argument to sh -c, so any of them turns a restricted command
          line into an unrestricted one.

    config MOONWATER_FLOODLIGHT_FIND_EXEC
        bool "find may run commands: -exec, -execdir, -ok, -okdir"
        default y
        help
          Off refuses those four find flags. Closes command execution per
          walked file, where the file names reaching the command are data an
          attacker can plant in the tree.

    config MOONWATER_FLOODLIGHT_FIND_DELETE
        bool "find may delete: -delete"
        default y
        help
          Off refuses find's -delete. Closes recursive destruction driven by
          names in a walked tree.

    config MOONWATER_FLOODLIGHT_FIND_WRITE
        bool "find may write files it names: -fprint, -fprint0, -fprintf"
        default y
        help
          Off refuses those find flags. Closes arbitrary file writes: each one
          creates or truncates the file named after it, with contents a
          format string controls.

    config MOONWATER_FLOODLIGHT_XARGS
        bool "xargs may run"
        default y
        help
          Off adds `xargs run deny`. Closes command lines built from input
          data: xargs has no use but running a command with what it read.

    config MOONWATER_FLOODLIGHT_SPLIT_FILTER
        bool "split may pipe each piece into a command: --filter"
        default y
        help
          Off refuses split's --filter (and its abbreviations, --fil and
          the like). Closes command execution per output chunk: --filter
          hands every piece to `sh -c COMMAND`, so the command runs as many
          times as the input has pieces, with the data on its stdin.

    config MOONWATER_FLOODLIGHT_SORT_COMPRESS
        bool "sort may run a compressor: --compress-program"
        default y
        help
          Off refuses sort's --compress-program (and its abbreviations).
          Closes running a program named on the command line with sort's
          temporary data: sort starts it for every spill it writes and
          reads back, as GNU's does.

    config MOONWATER_FLOODLIGHT_ENV_SPLIT
        bool "env may split a string into a command: -S, --split-string"
        default y
        help
          Off refuses env's -S and --split-string, including -S clustered
          with other short options or carrying its value (-iS, -S'cmd arg',
          and the one argument a #!/usr/bin/env -S line passes). Closes a
          command line derived from one string rather than typed as words.

          Floodlight reads every word of env's command line, the command it
          runs and that command's arguments included, and does not know
          which of them are env's own. So with this off, env refuses any
          single-dash word holding an S anywhere after it: `env sort -S 1G`,
          `env ls -lhS`, and a script started through `#!/usr/bin/env bash`
          whose own arguments carry one (`./script -lS`). env naming its
          command with no such word, as that #! line does, still runs.

    config MOONWATER_FLOODLIGHT_LAUNCHERS
        bool "command launchers may run: timeout, nice, nohup, stdbuf and kin"
        default y
        help
          Off adds run denials for timeout, nice, nohup, stdbuf, setsid,
          flock, chrt, ionice, taskset, prlimit, choom, uclampset, coresched,
          setpgid and pipesz. Closes the launcher shell escape: each one runs
          whatever its arguments name, so any of them allowed where a shell
          is not is a shell (`nice /bin/sh`).

    config MOONWATER_FLOODLIGHT_NAMESPACES
        bool "namespace, root and credential tools may run"
        default y
        help
          Off adds run denials for unshare, nsenter, chroot, pivot_root and
          setpriv. Closes entering or making namespaces, changing the root
          and changing credentials -- the moves that take a process out from
          under a policy scoped to it. mount and umount are not here: they
          are shell builtins as well as applets, and floodlight decides what
          a launch starts, not what the shell does itself.

    config MOONWATER_FLOODLIGHT_NETWORK_FETCH
        bool "wget and fetch may run"
        default y
        help
          Off adds run denials for wget and fetch. Closes downloading a next
          stage and sending files out with the tools this image carries.

    comment "Not switches: tar has no --to-command, -I, --checkpoint-action or"
    comment "--rsh-command and refuses --use-compress-program; sed has no e or"
    comment "s///e; awk has no /inet/; sed w and dd of=DEVICE are file writes"
    comment "floodlight cannot tell from any other. Name a policy row instead."

    endmenu

    config MOONWATER_SHELL
        bool "Bundle the Moonwater shell in the initial filesystem"
        depends on MOONWATER_CORE=y
        default y
        help
          Build the Spark shell and install it as /shell, /init and /bin/sh.
          Disable this when another initramfs supplies its own init and command
          interpreter. Disable MOONWATER_UTILITIES as well for a kernel-only
          image with no bundled userspace payload. The repository's fs/
          directory is generated output; point CONFIG_INITRAMFS_SOURCE at a
          separate tree or archive when supplying a replacement init.

    config MOONWATER_SHELL_MONITOR
        bool "Bundle the native resource monitor"
        depends on MOONWATER_SHELL && MOONWATER_UTILITIES
        default y
        help
          Build the persistent monitor applet and install monitor.sh plus its
          historical mointor.sh spelling as thin launchers. The monitor reads
          typed shared snapshots and keeps its previous sample in memory,
          avoiding the process and temporary-file cost of a shell dashboard.

    config MOONWATER_UTILITIES
        bool "Bundle the general utility surface"
        depends on MOONWATER_CORE=y
        default y
        help
          Build and install the core, file, text and network utility surface.
          When the shell is enabled its one shared binary provides the applets;
          otherwise a utility-only Spark entrypoint is built and unknown names
          cannot fall through into an interactive shell. The utility-only
          binary retains the /shell path used by the kernel's accelerated tool
          spawning ABI, but /bin/sh and /init are not installed.

          Disabling this option removes the applet registry roots so linker
          garbage collection drops their unreferenced code. Shared helpers
          still needed by the enabled shell remain.

    config MOONWATER_UTIL_LINUX
        bool "Bundle util-linux compatible utilities"
        depends on MOONWATER_UTILITIES
        default y
        help
          Install mount, process-policy, namespace and related util-linux
          compatible applet names, including their conventional /bin and
          /sbin aliases. Disabling this removes the util-linux registry roots;
          only helpers independently needed by another enabled component
          remain in the linked image.

    config MOONWATER_STRICT
        int "How strict this build is where safety and the reference disagree"
        depends on MOONWATER_UTILITIES
        range 0 3
        default 1
        help
          The utility surface is written against the tool on the machine
          rather than against a standard, because the tool is what a script
          actually meets. Now and then the reference has a hole in it, and
          matching it byte for byte means shipping the hole: util-linux's
          last writes a newline straight out of a utmp host field, so a
          hostname a remote peer chose can forge a line in the output.

          0 is the reference exactly -- every byte the tool on the machine
          writes, including the ones it should not. Choose it to diff our
          output against that tool, or when a script parses the hole on
          purpose.

          1 is the default: a divergence only where benign input is
          unaffected and hostile input was dangerous. That is the shape of
          the escaping above and of the symlinked-component refusal
          mkdir -p already makes.

          2 refuses where 1 sanitises, and tightens what a careful operator
          would want tightened even though ordinary use never arrives
          there.

          3 is 2, and what a machine that does one job and is never
          administered by hand can have shut for good: settings that stay
          until the next boot (no module loads, no ptrace attach, no
          process of another user in /proc) and refusals a person at a
          keyboard would notice. Every check that asks for 2 asks for 3 too.

          This is a ceiling on what the build will do, not a promise that
          every utility has something to say at every level. Most have
          nothing to say and never read it.

          The regions below lean on their own where this says nothing: a
          region left at -1 is this level.

    menu "Strictness by region"
        depends on MOONWATER_UTILITIES

    comment "Each follows MOONWATER_STRICT at -1 and has its own level 0 to 3 otherwise"

    config MOONWATER_STRICT_FILES
        int "FILES: what a tool does to a path it was given"
        range -1 3
        default -1
        help
          Links, sticky and world-writable directories, whether a copy is
          published whole or built where it will live, the security
          attributes an archive carries, and the fs.protected_* switches.
          At 2 mkdir, cp, install and every output open refuse the shapes
          a planted link or a directory anyone can write turn into a write
          somewhere else; see the table in README.md.

    config MOONWATER_STRICT_TEXT
        int "TEXT: what a tool writes to a terminal that another party chose"
        range -1 3
        default -1
        help
          utmp and mount names, a peer's host, an archive's member names, a
          process's comm and a disk's label. At 1 a byte a terminal acts on
          is spelled; at 0 it is written as the reference writes it, and at
          2 even the bell is.

    config MOONWATER_STRICT_NET
        int "NET: what a tool accepts from the wire and what it puts on a command line"
        range -1 3
        default -1
        help
          The HTTP framing the clients accept, a secret in an argument, the
          reply a clock accepts, and the kernel network settings written at
          boot. At 2 a 204 that declares a body and a 205 with content are
          refused, a secret in argv is refused, and a time reply of the
          wrong size is not read.

    config MOONWATER_STRICT_HOST
        int "HOST: what the machine takes from the media and the kernel it runs on"
        range -1 3
        default -1
        help
          Which disk a boot may take its script from, what media may
          announce, and the kernel settings init writes before it starts
          anything (kptr_restrict, io_uring, ptrace scope). At 2 a disk
          that is not the one the machine booted from is never taken
          without being asked, kptr_restrict is 2 and ptrace attach needs
          CAP_SYS_PTRACE; at 3 modules can no longer be loaded and nothing
          attaches at all.

    config MOONWATER_STRICT_BOWL
        int "BOWL: what a bowl makes on the user's behalf"
        range -1 3
        default -1
        help
          Whether a runtime directory that is missing is made at all (at 2
          it is not: a path nobody prepared is a typo).

    endmenu

    config MOONWATER_MACHINE_SCRIPT
        string "Default machine script"
        depends on MOONWATER_CORE
        default "main.moonwater.sh"
        help
          Path relative to the repository root, compiled into the module
          as the fallback machine script. The default is main.moonwater.sh
          next to README.md: clone the repo and edit that file. The
          machine process sources this text when /root/main.moonwater.sh
          is missing or refused, so a disk that never appears still has
          a working event table.

          moonwater bind and moonwater machine both read the overlay from
          the module; they do not each scan a private copy. A regular
          file at /root/main.moonwater.sh, owned by root and not group-
          or world-writable, overlays the baked text after boot.
    # Per-tool and per-builtin switches, generated: ./build switches
    source "kernel/moonwater/Kconfig.switches"
endmenu # Moonwater
```
