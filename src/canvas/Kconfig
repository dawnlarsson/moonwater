## src/canvas/Kconfig
```kconfig
menu "Moonwater Canvas"
    config MOONWATER_CANVAS
        bool "Moonwater Canvas, the kernel's side of the desktop"
        depends on MOONWATER_CORE=y && DRM && DRM_CLIENT
        default y
        help
          Own the display from kernel space until the desktop starts:
          Canvas claims each card as an in-kernel DRM client, chooses the
          mode and the scale, commits a first picture and holds the card
          until the compositor, a program, takes it as DRM master. When the
          compositor lets go of the card Canvas draws the ground again.
          Its source is src/canvas/, an object of its own beside the core,
          which is why the core has to be built in. Disable this option to
          omit it and the architecture-specific pixel assembly entirely;
          Moonwater core, Spark programs and the ordinary kernel consoles
          remain available.

    config MOONWATER_CANVAS_AUTOSTART
        bool "Bring Canvas up automatically during boot"
        depends on MOONWATER_CANVAS && MOONWATER_SHELL
        default y
        help
          Probe DRM devices and claim them as soon as display drivers
          appear, so the machine script can start the compositor.

          Disable this while keeping MOONWATER_CANVAS enabled to retain the
          compositor in the image without claiming a display at boot. The
          ordinary framebuffer, virtual or serial console then owns /dev/console
          and PID 1 starts the shell directly on it. Ensure the kernel command
          line does not contain drm_client_lib.active=, which intentionally
          suppresses the framebuffer console for a Canvas-first desktop.

    config MOONWATER_GPU
        bool "GPU rendering on Canvas's desktop"
        depends on MOONWATER_CANVAS
        default y
        help
          Let Canvas draw and compose on the GPU where it has a driver for
          it (src/canvas/gpu.c, userspace, the card's render node), and on the
          processor everywhere else. The Canvas setting "GPU rendering"
          (moonwater canvas gpu [on|off]) switches it at run time; this
          option takes the code out of the image altogether, and with it
          the setting.

    config MOONWATER_WAYLAND
        bool "Wayland clients on Canvas's desktop"
        depends on MOONWATER_CANVAS
        default n
        help
          Build the Wayland shim into the compositor (src/canvas/wayland.c
          and wayland_host.c, userspace): the compositor listens on
          /run/moonwater/wayland-0 and shows the windows of Wayland
          clients as it shows its own programs' (a row of the window table
          each), with their keys, pointer, frames, clipboard and sizes.
          It is not kernel code and adds nothing to the kernel's image.
          Off by default: with it off nothing of it is compiled and nothing
          a Wayland client sends can reach the compositor.

    config MOONWATER_X11
        bool "X11 programs on Canvas's desktop, through XWayland"
        depends on MOONWATER_WAYLAND
        default n
        help
          Start XWayland on the first X connection and be its window
          manager, so X11 programs are windows of the compositor. Not built
          yet: this switch only reserves its place beside the Wayland shim.

endmenu # Moonwater Canvas
```
