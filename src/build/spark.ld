/*
        Linker script for the spark format.

        The loader maps text, data and bss as three separate regions with
        different permissions, so each one has to start on a page boundary --
        otherwise two regions share a page and cannot be given different
        protections. Aligning here is what keeps the kernel side free of
        partial page fixups.

        SPARK_BASE has to match the base recorded in the spark header. The
        image carries absolute addresses, so it is mapped MAP_FIXED there.
*/

SPARK_BASE = 0x400000;

ENTRY(_start)

SECTIONS
{
        /* The spark header lives in the first 64 bytes of the mapped image,
           so the code starts just past it. The loader maps from SPARK_BASE and
           jumps to the entry recorded in the header, which points here. */
        . = SPARK_BASE + 64;

        /* Hot code first, cold code last, because what a program touches is
           what it pays for: a page is read in whole and stays, so a cold
           routine sitting between two hot ones is read in beside them and
           never used. The compiler already says which is which -- .text.hot
           and .text.startup for the code it expects to run, .text.unlikely
           for the error paths it does not -- and this is where that answer
           is worth anything. .moonwater.span_byte is the same idea written
           by hand, and it keeps its place beside them.

           An input section goes to the first pattern that matches it, so
           .text.unlikely has to be named before the catch-all below or the
           catch-all takes it and the order here means nothing. The hot/cold
           jumps this separates are already cross-section and relocated to
           32 bits, so no distance inside an image can be too far. */
        .text : {
                /* What the commands of a shell run, in the order of how many
                   of them run it, one section a function (-ffunction-sections)
                   so that the common start is a few pages and not seventeen
                   of them: a text fault maps sixteen pages of the file and
                   the exit unmaps them again, about a microsecond a window
                   measured, and a start touched seventeen. The list is the
                   functions that 26 commands executed under qemu-user, taken
                   from the link map (python3 test/differential.py --harness
                   hot_order SHELL MAP --write, between the two markers); a
                   name that is not in a program is ignored, and an asm routine stays in its own list below
                   (riscv64's jal between them reaches a megabyte). */
                /* What a start reads, first, so that it is on the pages of the
                   first functions: the tables it indexes (HOT_RODATA) and the
                   byte-class and case tables the library keeps in assembly. */
                *(.rodata.hot)
                *(.rodata.byte_commonness .rodata.unicode_case_tab)
                *(.rodata.string_set_*)
                *(.text.exit)
                /* hot_order begin */
                *(.text.startup.main)
                *(.text.moonwater_program_main)
                *(.text.shell_name_scan.part.0.constprop.0)
                *(.text.hot.shell_tool_name)
                *(.text.hot.shell_tool_named_in)
                *(.text.hot.stdlib_exit)
                *(.text.unlikely.array_table_release)
                *(.text.bowl_path_same.part.0)
                *(.text.bowl_path_steps.part.0)
                *(.text.bowl_session_assign)
                *(.text.bowl_session_fill)
                *(.text.bowl_session_host_path.part.0)
                *(.text.bowl_session_prepare_at)
                *(.text.unlikely.env_attribute_target_span)
                *(.text.hot.env_borrow_assignment.isra.0)
                *(.text.unlikely.env_borrow_plain.isra.0)
                *(.text.hot.env_export_mark_span)
                *(.text.unlikely.env_export_mark_span)
                *(.text.hot.env_find_hashed_span)
                *(.text.hot.env_get_hashed_span)
                *(.text.unlikely.env_get_hashed_span)
                *(.text.hot.env_record_append)
                *(.text.unlikely.env_reference_destination)
                *(.text.unlikely.env_reference_span)
                *(.text.unlikely.env_table_room.part.0)
                *(.text.unlikely.env_unset_noted)
                *(.text.hot.env_variable_drop)
                *(.text.unlikely.env_variable_drop)
                *(.text.hot.exec_control_builtin)
                *(.text.hot.exec_dispatch)
                *(.text.hot.exec_function_import_environment)
                *(.text.hot.exec_node)
                *(.text.hot.exec_program)
                *(.text.hot.exec_simple)
                *(.text.expand_sets_prepare.part.0)
                *(.text.lex_prepare.part.0)
                *(.text.hot.parse_at_list_end)
                *(.text.hot.parse_command_body)
                *(.text.parse_copy_lex)
                *(.text.hot.parse_feed)
                *(.text.unlikely.parse_feed)
                *(.text.hot.parse_list)
                *(.text.hot.parse_node_new)
                *(.text.hot.parse_pipeline.constprop.0)
                *(.text.hot.parse_program)
                *(.text.hot.parse_redirect_prefix)
                *(.text.hot.parse_take_word)
                *(.text.hot.parse_word_is_length)
                *(.text.hot.parse_word_new)
                *(.text.hot.run_line)
                *(.text.hot.run_line_inner)
                *(.text.unlikely.run_line_inner)
                *(.text.hot.shell_builtin)
                *(.text.hot.shell_command_index_hashed)
                *(.text.hot.shell_directory_holds)
                *(.text.hot.shell_env_init)
                *(.text.unlikely.shell_env_init)
                *(.text.hot.shell_map)
                *(.text.hot.shell_options_started)
                *(.text.hot.shell_parameters_set)
                *(.text.unlikely.shell_room_grow)
                *(.text.shell_run_known_line)
                *(.text.hot.shell_signals_settle)
                *(.text.shell_start_parameters)
                *(.text.unlikely.shell_start_parameters)
                *(.text.hot.shell_store_copy)
                *(.text.unlikely.shell_store_copy)
                *(.text.unlikely.shell_store_take_block)
                *(.text.unlikely.shell_substitutions_parse)
                *(.text.hot.shell_verbose_line)
                *(.text.hot.exec_errexit)
                *(.text.unlikely.exec_simple)
                *(.text.hot.exec_traps)
                *(.text.hot.parse_reset)
                *(.text.hot.shell_expand_reset)
                *(.text.hot.shell_trap_exit)
                *(.text.hot.trap_detach.constprop.0)
                *(.text.hot.lex_grow)
                *(.text.unlikely.lex_grow)
                *(.text.hot.exec_redirect_apply)
                *(.text.hot.exec_save_duplicate)
                *(.text.hot.exec_save_fd)
                *(.text.hot.parse_take_redirect.isra.0)
                *(.text.hot.shell_expand_word)
                *(.text.hot.exec_redirect_restore)
                *(.text.unlikely.shell_expand_word)
                *(.text.floodlight_load)
                *(.text.hot.shell_tool_find_hashed)
                *(.text.floodlight_launch_decide)
                *(.text.floodlight_may.constprop.0)
                *(.text.hot.shell_child_default)
                *(.text.floodlight_flag_refused)
                *(.text.floodlight_says_length)
                *(.text.hot.shell_environment)
                *(.text.unlikely.shell_environment)
                *(.text.hot.shell_tool_call_in)
                *(.text.hot.tools_meta_asked)
                *(.text.hot.file_take_from)
                *(.text.file_environment_all)
                *(.text.hot.text_begin)
                *(.text.hot.shell_echo)
                *(.text.hot.text_done)
                *(.text.hot.text_reader_open)
                *(.text.hot.lex_word)
                *(.text.unlikely.parse_list)
                *(.text.hot.expand_into)
                *(.text.hot.expand_push_run)
                *(.text.unlikely.expand_push_run)
                *(.text.hot.lex_unfinished)
                *(.text.hot.text_fill_amount.constprop.0)
                *(.text.text_reader_fill_amount.part.0)
                *(.text.hot.text_write_out)
                *(.text.hot.expand_split)
                *(.text.hot.expand_word)
                *(.text.hot.expand_word_ready)
                *(.text.hot.shell_clone_raw)
                *(.text.hot.shell_expand_braces)
                *(.text.hot.shell_expand_fields)
                *(.text.hot.text_regular_size)
                *(.text.hot.env_cell_take)
                *(.text.unlikely.env_cell_take)
                *(.text.hot.env_write_noted)
                *(.text.env_write_whole)
                *(.text.unlikely.env_write_whole)
                *(.text.hot.parse_want_push_for)
                *(.text.hot.test_unary)
                *(.text.hot.text_file_add)
                *(.text.hot.trap_default_all)
                *(.text.hot.allocator_spend_remainder)
                *(.text.hot.allocator_take)
                *(.text.hot.allocator_take_slow)
                *(.text.hot.expand_dollar)
                *(.text.hot.expand_emit.isra.0)
                *(.text.hot.expand_keep_field)
                *(.text.hot.hash_remember)
                *(.text.unlikely.lex_word)
                *(.text.hot.locale_environment)
                *(.text.hot.locale_open)
                *(.text.hot.parallel_lines_open)
                *(.text.hot.path_walk_join)
                *(.text.unlikely.shell_dynamic_assign)
                *(.text.unlikely.shell_dynamic_removed)
                *(.text.hot.shell_exec_file_depth)
                *(.text.hot.shell_find_in_path_alloc_mode.part.0.constprop.0)
                *(.text.unlikely.shell_find_in_path_alloc_mode.part.0.constprop.0)
                *(.text.hot.shell_find_in_path_mode.part.0)
                *(.text.hot.shell_spawn_preflighted)
                *(.text.shell_utf8_on.part.0)
                *(.text.hot.text_lines_open)
                *(.text.hot.text_locale_utf8)
                *(.text.cat_one)
                *(.text.collate_ready)
                *(.text.env_bash_readonly_name)
                *(.text.env_readonly)
                *(.text.env_write.constprop.0)
                *(.text.exec_child_began)
                *(.text.unlikely.expand_emit.isra.0)
                *(.text.hot.expand_push_parameter_as)
                *(.text.hot.expand_simple)
                *(.text.unlikely.expand_split)
                *(.text.hot.expand_value_of)
                *(.text.hot.file_open_same_facts)
                *(.text.file_output_told)
                *(.text.glob_magic)
                *(.text.locale_string)
                *(.text.memory_resize.part.0)
                *(.text.memory_resize_growth)
                *(.text.memory_usable_size)
                *(.text.hot.parallel_width)
                *(.text.regex_compile)
                *(.text.unlikely.regex_compile)
                *(.text.rx_alternation)
                *(.text.rx_compile.constprop.0)
                *(.text.rx_edges)
                *(.text.unlikely.rx_match_scratch.constprop.0)
                *(.text.rx_operator)
                *(.text.rx_required)
                *(.text.shell_child_death)
                *(.text.shell_parser_source_fork_prepare)
                *(.text.shell_scalar_assign_destination)
                *(.text.hot.shell_test)
                *(.text.unlikely.system_open_parent_pinned)
                *(.text.text_cat)
                *(.text.text_literal_find)
                *(.text.text_put)
                *(.text.unlikely.utility_held_now)
                *(.text.allocator_give_slow)
                *(.text.unlikely.array_element_write)
                *(.text.unlikely.array_locate.isra.0)
                *(.text.unlikely.array_table_edit)
                *(.text.unlikely.array_table_take)
                *(.text.awk_array_find_hash.isra.0)
                *(.text.awk_array_place)
                *(.text.awk_assignment)
                *(.text.awk_builder_put)
                *(.text.awk_builder_room)
                *(.text.awk_cell_array)
                *(.text.awk_fields_reserve)
                *(.text.awk_global_find)
                *(.text.awk_leave)
                *(.text.awk_main_next_record)
                *(.text.awk_next_token)
                *(.text.awk_node_new)
                *(.text.awk_output_of)
                *(.text.hot.awk_piece_add)
                *(.text.awk_print_statement)
                *(.text.awk_read_record)
                *(.text.awk_reader_fill.part.0)
                *(.text.awk_run.part.0)
                *(.text.awk_simple_statement)
                *(.text.awk_split_pieces)
                *(.text.awk_split_record)
                *(.text.awk_stack_room_set)
                *(.text.awk_statement)
                *(.text.awk_statement_list.constprop.0)
                *(.text.awk_take)
                *(.text.awk_text_drop)
                *(.text.awk_text_new.part.0)
                *(.text.awk_to_number)
                *(.text.awk_to_text)
                *(.text.awk_writer_flush.isra.0)
                *(.text.awk_writer_put)
                *(.text.clock_break_down)
                *(.text.clock_civil_from_days)
                *(.text.clock_composite_format)
                *(.text.clock_format.part.0)
                *(.text.clock_format_append)
                *(.text.clock_format_core.constprop.0)
                *(.text.clock_format_gnu)
                *(.text.clock_format_number)
                *(.text.clock_format_run)
                *(.text.clock_history_at)
                *(.text.clock_history_load)
                *(.text.clock_tz_current)
                *(.text.clock_tz_name.constprop.0)
                *(.text.clock_tz_offset)
                *(.text.clock_tz_parse)
                *(.text.clock_tz_rule)
                *(.text.date_calendar_kind)
                *(.text.date_emit)
                *(.text.date_flagged_put)
                *(.text.date_shape)
                *(.text.env_assignment_readonly_destination)
                *(.text.env_export_take_hashed)
                *(.text.unlikely.env_reference_readonly.isra.0)
                *(.text.unlikely.env_restricted_name)
                *(.text.env_saved_state)
                *(.text.exec_assign_value)
                *(.text.exec_call)
                *(.text.unlikely.exec_call)
                *(.text.exec_child_leave)
                *(.text.exec_child_signals)
                *(.text.exec_define)
                *(.text.unlikely.exec_define)
                *(.text.exec_for)
                *(.text.unlikely.exec_for)
                *(.text.exec_literal_tool)
                *(.text.exec_node_parent_policy_prepare)
                *(.text.exec_pipe)
                *(.text.unlikely.exec_pipe)
                *(.text.unlikely.exec_pipe_status_publish)
                *(.text.exec_special_active)
                *(.text.exec_special_kind)
                *(.text.exec_stage_spawn)
                *(.text.exec_trace_for_header)
                *(.text.exec_wait_status.constprop.0)
                *(.text.expand_assignment_arithmetic)
                *(.text.expand_command)
                *(.text.expand_drop_empty)
                *(.text.expand_read_substitution)
                *(.text.expand_run)
                *(.text.unlikely.expand_run)
                *(.text.expand_substitution_body)
                *(.text.file_date)
                *(.text.hot.file_direct_endpoint_open)
                *(.text.file_find)
                *(.text.hot.file_link_chain_open.constprop.0)
                *(.text.hot.file_look_code.constprop.1)
                *(.text.file_ls)
                *(.text.file_ls_as)
                *(.text.hot.file_name_stable)
                *(.text.unlikely.file_parent_open)
                *(.text.hot.file_staged_name_finish.constprop.0)
                *(.text.unlikely.file_staged_name_open)
                *(.text.unlikely.file_staged_name_open_at)
                *(.text.file_tree_node_take.constprop.0)
                *(.text.file_unsigned_decimal)
                *(.text.file_walk_next)
                *(.text.find_facts_ready.part.0)
                *(.text.find_make)
                *(.text.unlikely.find_make)
                *(.text.find_name_write)
                *(.text.find_parse_level)
                *(.text.find_parse_primary)
                *(.text.find_tree_enter)
                *(.text.find_tree_holds)
                *(.text.find_tree_leave)
                *(.text.find_tree_sink)
                *(.text.find_tree_test)
                *(.text.find_true)
                *(.text.find_true_test)
                *(.text.find_walk_root)
                *(.text.unlikely.find_walk_root)
                *(.text.getenv)
                *(.text.glob_extended_anywhere)
                *(.text.grep_hold_release)
                *(.text.grep_one)
                *(.text.grep_operand)
                *(.text.grep_option_seen)
                *(.text.grep_pattern_add)
                *(.text.grep_plan_of)
                *(.text.grep_span)
                *(.text.http_dot_segment)
                *(.text.http_get_request)
                *(.text.http_link_open)
                *(.text.http_origin_form.constprop.0)
                *(.text.http_request_component_valid)
                *(.text.http_run)
                *(.text.http_scheme_length)
                *(.text.http_split_into.constprop.0)
                *(.text.http_stream_open)
                *(.text.http_web_scheme)
                *(.text.lex_assignment_head)
                *(.text.hot.lex_line)
                *(.text.unlikely.lex_nest_enter)
                *(.text.lex_nest_leave)
                *(.text.lex_nesting)
                *(.text.lex_nesting_at)
                *(.text.localtime_r)
                *(.text.ls_add.part.0)
                *(.text.ls_aligns_quotes)
                *(.text.ls_color_finish)
                *(.text.ls_directory)
                *(.text.ls_frills_before)
                *(.text.ls_mark_after)
                *(.text.ls_name_compare)
                *(.text.ls_name_emit)
                *(.text.ls_out)
                *(.text.ls_print.part.0)
                *(.text.ls_quote)
                *(.text.ls_room_for)
                *(.text.ls_sort)
                *(.text.net_wget)
                *(.text.unlikely.net_wget)
                *(.text.unlikely.net_wget_failed)
                *(.text.network_stream_timeout.part.0.constprop.0)
                *(.text.parallel_for)
                *(.text.parallel_reserve)
                *(.text.parallel_tree)
                *(.text.parallel_tree_await)
                *(.text.parallel_tree_enter)
                *(.text.parallel_tree_pin)
                *(.text.parallel_tree_record)
                *(.text.parallel_tree_release)
                *(.text.parse_at_compound)
                *(.text.parse_do_body)
                *(.text.parse_enclosed)
                *(.text.parse_expect_operator.constprop.0)
                *(.text.parse_for)
                *(.text.parse_for_body)
                *(.text.parse_function)
                *(.text.parse_if_tail)
                *(.text.parse_keep_measure)
                *(.text.parse_keep_tree)
                *(.text.parse_kept_frontiers)
                *(.text.parse_nest_enter)
                *(.text.unlikely.parse_nest_enter)
                *(.text.parse_nest_leave)
                *(.text.parse_redirect_brace)
                *(.text.parse_release)
                *(.text.parse_reserved.constprop.0)
                *(.text.parse_reset_all)
                *(.text.regex_keep)
                *(.text.run_lines)
                *(.text.rx_find)
                *(.text.sed_compile_regex)
                *(.text.sed_input_ends)
                *(.text.sed_operand)
                *(.text.unlikely.sed_output_follow)
                *(.text.unlikely.sed_output_start_slow)
                *(.text.sed_parse)
                *(.text.sed_parse_address)
                *(.text.sed_put_space)
                *(.text.unlikely.sed_put_space)
                *(.text.sed_script_add)
                *(.text.unlikely.sed_stdio_follow)
                *(.text.sed_take_until)
                *(.text.sed_text_add)
                *(.text.unlikely.shell_array_clear_mode)
                *(.text.unlikely.shell_array_length)
                *(.text.unlikely.shell_array_numbers)
                *(.text.unlikely.shell_array_reference.constprop.0)
                *(.text.unlikely.shell_array_replace)
                *(.text.unlikely.shell_array_set_destination)
                *(.text.shell_expand_assignment)
                *(.text.shell_expand_pattern)
                *(.text.unlikely.shell_export)
                *(.text.unlikely.shell_frames_wanted)
                *(.text.shell_line_now)
                *(.text.shell_local_enter)
                *(.text.unlikely.shell_local_enter)
                *(.text.shell_local_leave)
                *(.text.unlikely.shell_marked)
                *(.text.shell_match_folded)
                *(.text.shell_parameters_restore)
                *(.text.shell_parameters_save)
                *(.text.unlikely.shell_parameters_save)
                *(.text.unlikely.shell_parameters_set)
                *(.text.shell_pipe_status_wanted)
                *(.text.shell_printf)
                *(.text.unlikely.shell_substitution_parses)
                *(.text.unlikely.shell_valid_name)
                *(.text.shell_variable_attribute_apply)
                *(.text.unlikely.shell_variable_attribute_apply)
                *(.text.unlikely.shell_variable_attribute_destination)
                *(.text.unlikely.shell_variable_attribute_set)
                *(.text.sort_chunk)
                *(.text.sort_emit)
                *(.text.sort_emit_serial)
                *(.text.sort_entries_close)
                *(.text.sort_group)
                *(.text.sort_items_iota_job)
                *(.text.sort_line_record)
                *(.text.sort_operand)
                *(.text.sort_output_close)
                *(.text.sort_output_take)
                *(.text.sort_release)
                *(.text.sort_sources_close)
                *(.text.sort_split)
                *(.text.sort_write_all)
                *(.text.spelling_c)
                *(.text.stdlib_arena_take)
                *(.text.stdlib_environment_own.part.0)
                *(.text.test_is_unary)
                *(.text.hot.test_short)
                *(.text.text_awk)
                *(.text.unlikely.text_awk)
                *(.text.text_digits_misplaced.isra.0)
                *(.text.text_done_closing)
                *(.text.text_grep)
                *(.text.text_head)
                *(.text.text_reader_spill)
                *(.text.text_sed)
                *(.text.text_sort)
                *(.text.text_tr)
                *(.text.text_wc)
                *(.text.tr_add)
                *(.text.tr_members)
                *(.text.tr_next)
                *(.text.tr_parse)
                *(.text.tr_stats)
                *(.text.tzset)
                *(.text.utility_arena_take)
                *(.text.wc_option_seen)
                *(.text.wc_row)
                *(.text.writer_terminal_quoted_name)
                /* hot_order end */
                *(.text.hot .text.hot.*)
                *(.text.startup .text.startup.*)
                *(.text .text.exit .text.exit.*)

                *(.moonwater.span_byte)
                /* The configuration record, which nothing reads at run time
                   and the build looks for in the image: named before
                   .rodata.* so garbage collection cannot take it. */
                KEEP(*(.rodata.moonwater_config))
                *(.rodata .rodata.*)
                /* riscv64 puts read only globals of a few bytes here. */
                *(.srodata .srodata.*)
                /* Tables of pointers that are const and so never written: with the
                   rodata, where a read of one is a fault on a page that is
                   mapped already or a clean one, not a page of .data. */
                *(.data.rel.ro .data.rel.ro.*)

                *(.text.unlikely .text.unlikely.*)
                /* The routines written in assembly that every command runs,
                   each in a section of its own (ASM_FUNC), first among the
                   rest: what the library's routines call one another with
                   on riscv64 is a jal, which reaches a megabyte, so they
                   stay together instead of going to the front, and a
                   command touches this part of the image as one run of
                   pages rather than one a routine. */
                *(.text._start)
                /* hot_asm begin */
                *(.text._start)
                *(.text.exit)
                *(.text.memory_compare)
                *(.text.moonwater_cpu_detect)
                *(.text.program_argument)
                *(.text.program_argument_count)
                *(.text.program_argument_list)
                *(.text.program_environment_list)
                *(.text.program_initial_identity)
                *(.text.shell_key_next)
                *(.text.string_compare)
                *(.text.string_last_of)
                *(.text.string_span)
                *(.text.system_call_3)
                *(.text.buffered_flush)
                *(.text.env_find_hashed_span_probe)
                *(.text.exec_function_slot)
                *(.text.lex_line_floor)
                *(.text.lex_line_store)
                *(.text.log_failure_reset)
                *(.text.log_flush)
                *(.text.memory_copy)
                *(.text.memory_copy_apart)
                *(.text.memory_copy_end)
                *(.text.memory_count)
                *(.text.memory_first_of)
                *(.text.memory_growth)
                *(.text.memory_hash_33)
                *(.text.parse_keyword_of)
                *(.text.parse_word_kind)
                *(.text.positive_into_core)
                *(.text.positive_into_string)
                *(.text.string_copy_max_end)
                *(.text.string_digits)
                *(.text.string_first_of)
                *(.text.string_first_of_or_end)
                *(.text.string_hash_33_length)
                *(.text.string_set_add)
                *(.text.system_call)
                *(.text.system_call_5)
                *(.text.system_call_6)
                *(.text.log_failed)
                *(.text.system_call_1)
                *(.text.system_call_4)
                *(.text.memory)
                *(.text.program_arguments_use)
                *(.text.argument_option_take)
                *(.text.system_read_retry)
                *(.text.string_get_environment)
                *(.text.memory_reserve)
                *(.text.system_call_2)
                *(.text.memory_copy_apart_end)
                *(.text.memory_span_byte)
                *(.text.string_span_max)
                *(.text.string_table_find)
                *(.text.memory_free)
                *(.text.system_wait4_retry)
                *(.text.wait_status_code)
                *(.text.wait_status_code_base)
                *(.text.env_write_destination)
                *(.text.log)
                *(.text.memory_give)
                *(.text.buffered_write)
                *(.text.buffered_write_core)
                *(.text.memory_take)
                *(.text.positive_into)
                *(.text.bipolar_into_core)
                *(.text.bipolar_into_string)
                *(.text.memory_release)
                *(.text.memory_search_prepare)
                *(.text.memory_search_prepared)
                *(.text.positive_digits_core)
                *(.text.string_copy)
                *(.text.bytes_reverse_16)
                *(.text.bytes_reverse_32)
                *(.text.get_cpu_time)
                *(.text.lock_release)
                *(.text.lock_take)
                *(.text.log_error)
                *(.text.memory_compare_ascii_case)
                *(.text.memory_into_spelled)
                *(.text.memory_nth_of)
                *(.text.memory_offsets_fields_blank)
                *(.text.memory_offsets_fields_x64)
                *(.text.memory_span_byte_reverse)
                *(.text.memory_translate)
                *(.text.path_split_core)
                *(.text.path_tail_copy)
                *(.text.positive_to_padded)
                *(.text.positive_to_string)
                *(.text.socket_close)
                *(.text.socket_connect)
                *(.text.socket_new)
                *(.text.socket_option_set)
                *(.text.string_digits_max)
                *(.text.string_format)
                *(.text.string_report)
                *(.text.string_to_host)
                /* hot_asm end */
                spark_hot_end = .;
                *(.text.*)
        }

        . = ALIGN(4096);

        .data : {
                *(.data.hot)
                *(.data .data.*)
                *(.got .got.plt)
                /* And small writable ones here, one section each because the
                   programs are built with -fdata-sections. Unmatched, they
                   were placed wherever the linker felt like, which on riscv64
                   is outside every region the loader maps. */
                *(.sdata .sdata.*)
                /* Whole pages in the file, so that the kernel has no tail of
                   the last one to zero before the bss starts: that zeroing
                   copies a page of the file at every exec. */
                . = ALIGN(4096);
        }

        /* RISC-V _start establishes gp as required by its psABI.  Ordinary
           ELF linker scripts provide this anchor themselves; spark owns its
           complete layout and therefore has to provide it explicitly.  The
           conventional 0x800 bias reaches the full signed twelve-bit window
           around small data.  Other architectures simply leave it unused. */
        PROVIDE(__global_pointer$ = . + 0x800);

        . = ALIGN(4096);

        .bss : {
                __bss_start = .;
                /* What every command writes, on the first page and no
                   other, so a fork copies the one page (HOT_STATE). */
                *(.bss.hot)
                /* Library state every process writes before main, one section
                   each because it is written in assembly (ASM_BSS_OBJECT_BEGIN). */
                *(.bss.program_stack_base .bss.thread_main .bss.threads_live
                  .bss.log_writer_buffer_length .bss.log_writer_failed
                  .bss.writer_stderr_failed
                  .bss.program_vdso_clock .bss.program_entry_identity .bss.program_entry_facts
                  .bss.program_words
                  .bss.cpu_has_* .bss.cpu_hash_probed
                  .bss.program_words_count)
                /* The big ones last, each written at its first bytes: they
                   start on the page the small ones leave half empty. */
                *(.bss.hot.tail)
                *(.bss.log_writer_buffer .bss.working_directory)
                /* The pool tables and store blocks are carved from (lib.c), after
                   the statics so that its first page is the last of theirs. */
                *(.bss.memory_pool_block)
                *(.bss .bss.*)
                *(.sbss .sbss.*)
                *(COMMON)
                . = ALIGN(4096);
                __bss_end = .;
        }

        /* Nothing else is loadable: the format has no section table, no
           dynamic linking and no unwind information. */
        /DISCARD/ : {
                /* A __thread object would be reached at a link-time offset
                   from the thread register, and the register points at the
                   explicit thread block in library.c, not at a TLS
                   image. Discarding the sections turns any such object into a
                   link error naming it, instead of a store into another
                   field of the block. */
                *(.tdata .tdata.* .tbss .tbss.*)
                *(.comment)
                *(.note .note.*)
                *(.eh_frame .eh_frame_hdr)
                *(.gnu.hash .hash .dynsym .dynstr)
        }
}

/* What a start touches ends at spark_hot_end, and the image begins on a 2 MiB
   boundary (SPARK_BASE is 4 MiB), so while it ends inside the first 2 MiB the
   page cache can hold the whole of it as one huge page and a start maps it
   with one entry (kernel/profile/any: TMPFS_HUGE_WITHIN_SIZE). A product link
   passes SPARK_HOT_LIMIT, the 2 MiB, and a hot set that has grown past it is
   not linked; a program linked without it is not checked. */
PROVIDE(SPARK_HOT_LIMIT = 0);
ASSERT(SPARK_HOT_LIMIT == 0 || spark_hot_end - SPARK_BASE <= SPARK_HOT_LIMIT,
       "the hot set of the image ends past the first 2 MiB: a start no longer maps it with one huge page")
